## Kconfig
```
# Private config options for routing sample app

# Copyright (c) 2018 Intel Corporation
# SPDX-License-Identifier: Apache-2.0

mainmenu "Networking routing sample application"

config NET_SAMPLE_IFACE1_DEV
	string "Device name for the first interface"
	default "zeth1"
	help
	  The device name of the interface to be configured.

config NET_SAMPLE_IFACE1_PREFIX
	string "Prefix for the first interface"
	help
	  It is used in Router Advertisements messages and defines the network
	  address of the first interface.

config NET_SAMPLE_IFACE1_PREFIX_LEN
	int "Prefix length for the first interface"
	default 64
	help
	  Length of the prefix.

config NET_SAMPLE_IFACE2_DEV
	string "Device name for the second interface"
	default "zeth2"
	help
	  The device name of the interface to be configured.

config NET_SAMPLE_IFACE2_PREFIX
	string "Prefix for the second interface"
	help
	  It is used in Router Advertisements messages and defines the network
	  address of the first interface.

config NET_SAMPLE_IFACE2_PREFIX_LEN
	int "Prefix length for the second interface"
	default 64
	help
	  Length of the prefix.



config NET_SAMPLE_NUM_HANDLERS
	int "How many connections to serve at the same time"
	default 1
	help
	  Each connection is served by a thread which needs
	  memory. Only increase the value here if really needed.

config NET_SAMPLE_IFACE2_MY_IPV6_ADDR
	string "My IPv6 address for second interface"
	help
	  The value depends on your network setup.

config NET_SAMPLE_IFACE2_MY_IPV4_ADDR
	string "My IPv4 address for second interface"
	help
	  The value depends on your network setup.

config NET_SAMPLE_IFACE2_VLAN_TAG
	int "VLAN tag for second interface"
	default 100
	range 0 4094
	depends on NET_VLAN
	help
	  Set VLAN (virtual LAN) tag (id) that is used in the sample
	  application.

config NET_SAMPLE_IFACE3_MY_IPV6_ADDR
	string "My IPv6 address for third interface"
	help
	  The value depends on your network setup.

config NET_SAMPLE_IFACE3_MY_IPV4_ADDR
	string "My IPv4 address for third interface"
	help
	  The value depends on your network setup.

config NET_SAMPLE_IFACE3_VLAN_TAG
	int "VLAN tag for third interface"
	default 200
	range 0 4094
	depends on NET_VLAN
	help
	  Set VLAN (virtual LAN) tag (id) that is used in the sample
	  application.

config NET_SAMPLE_PSK_HEADER_FILE
	string "Header file containing PSK"
	default "dummy_psk.h"
	depends on MBEDTLS_KEY_EXCHANGE_PSK_ENABLED
	help
	  Name of a header file containing a
	  pre-shared key.

config NET_SAMPLE_CERTS_WITH_SC
	bool "Signed certificates"
	depends on NET_SOCKETS_SOCKOPT_TLS
	help
	  Enable this flag, if you are interested to run this
	  application with signed certificates and keys.

choice
	prompt "Socket mode"
	default NET_SAMPLE_SYNC_SOCKETS

config NET_SAMPLE_SYNC_SOCKETS
	bool "Synchronized sockets"
	help
	  Use synchronized sockets (i.e. regular sockets)

config NET_SAMPLE_ASYNC_SOCKETS_POLL
	bool "Async sockets"
	help
	  Enable this flag, if you want the sample to use asynch sockets using
	  poll

endchoice

source "Kconfig.zephyr"
```

## prj.conf
```kconfig
CONFIG_NO_OPTIMIZATIONS=y
CONFIG_LOG_DEFAULT_LEVEL=3
CONFIG_ETHERNET_LOG_LEVEL_DBG=y
CONFIG_NET_IPV6_LOG_LEVEL_DBG=y

CONFIG_NETWORKING=y
CONFIG_NET_UDP=y
CONFIG_NET_TCP=y
CONFIG_NET_IPV6=y
CONFIG_NET_IPV4=y
#CONFIG_NET_DHCPV4=y
CONFIG_NET_ROUTING=y

CONFIG_ENTROPY_GENERATOR=y
CONFIG_TEST_RANDOM_GENERATOR=y
CONFIG_INIT_STACKS=y

CONFIG_NET_LOG=y
CONFIG_LOG=y

CONFIG_NET_STATISTICS=y

CONFIG_NET_PKT_RX_COUNT=32
CONFIG_NET_PKT_TX_COUNT=32
CONFIG_NET_BUF_RX_COUNT=32
CONFIG_NET_BUF_TX_COUNT=32

CONFIG_NET_IF_MAX_IPV4_COUNT=2
CONFIG_NET_IF_MAX_IPV6_COUNT=2
CONFIG_NET_IF_UNICAST_IPV6_ADDR_COUNT=3
CONFIG_NET_IF_MCAST_IPV6_ADDR_COUNT=4
CONFIG_NET_MAX_CONTEXTS=10

CONFIG_NET_SHELL=y

CONFIG_NET_CONFIG_SETTINGS=y
CONFIG_NET_CONFIG_NEED_IPV6=y
CONFIG_NET_CONFIG_NEED_IPV4=y
CONFIG_NET_CONFIG_MY_IPV6_ADDR="2001:db8:100::1"
CONFIG_NET_CONFIG_PEER_IPV6_ADDR="2001:db8:100::2"
CONFIG_NET_CONFIG_MY_IPV4_ADDR="192.0.2.1"
CONFIG_NET_CONFIG_PEER_IPV4_ADDR="192.0.2.2"
CONFIG_NET_SAMPLE_IFACE1_PREFIX="2001:db8:100::"
CONFIG_NET_SAMPLE_IFACE2_PREFIX="2001:db8:200::"

CONFIG_NET_L2_ETHERNET=y

CONFIG_ETH_NATIVE_POSIX=y
CONFIG_ETH_NATIVE_POSIX_RANDOM_MAC=n
CONFIG_ETH_NATIVE_POSIX_MAC_ADDR="00:00:5e:00:53:01"
CONFIG_ETH_NATIVE_POSIX_DRV_NAME="zeth1"

CONFIG_ETH_NATIVE_POSIX_SECOND_IFACE=y
CONFIG_ETH_NATIVE_POSIX_DRV_NAME_2="zeth2"
CONFIG_ETH_NATIVE_POSIX_MAC_ADDR_2="00:00:5e:00:53:11"
```

## prj_zephyr1.conf
```kconfig
CONFIG_NET_CONFIG_SETTINGS=y
CONFIG_NET_CONFIG_NEED_IPV6=y
CONFIG_NET_CONFIG_NEED_IPV4=y

CONFIG_NET_CONFIG_MY_IPV4_ADDR="198.51.100.1"
CONFIG_NET_CONFIG_PEER_IPV4_ADDR="203.0.113.1"
CONFIG_NET_CONFIG_MY_IPV4_GW="203.0.113.1"

CONFIG_NET_CONFIG_MY_IPV6_ADDR="2001:db8:100::2"
CONFIG_NET_CONFIG_PEER_IPV6_ADDR="2001:db8:200::2"

CONFIG_ETH_NATIVE_POSIX_DRV_NAME="zeth0"
CONFIG_ETH_NATIVE_POSIX_MAC_ADDR="00:00:5e:00:53:02"
CONFIG_ETH_NATIVE_POSIX_RANDOM_MAC=n

CONFIG_NET_L2_ETHERNET=y
CONFIG_ETH_NATIVE_POSIX=y

CONFIG_NET_HOSTNAME_ENABLE=y
CONFIG_NET_HOSTNAME="zephyr1"
```

## prj_zephyr2.conf
```kconfig
CONFIG_NET_CONFIG_SETTINGS=y
CONFIG_NET_CONFIG_NEED_IPV6=y
CONFIG_NET_CONFIG_NEED_IPV4=y

CONFIG_NET_CONFIG_MY_IPV4_ADDR="203.0.113.1"
CONFIG_NET_CONFIG_PEER_IPV4_ADDR="198.51.100.1"
CONFIG_NET_CONFIG_MY_IPV4_GW="198.51.100.1"

CONFIG_NET_CONFIG_MY_IPV6_ADDR="2001:db8:200::2"
CONFIG_NET_CONFIG_PEER_IPV6_ADDR="2001:db8:100::2"

CONFIG_ETH_NATIVE_POSIX_DRV_NAME="zeth3"
CONFIG_ETH_NATIVE_POSIX_MAC_ADDR="00:00:5e:00:53:22"
CONFIG_ETH_NATIVE_POSIX_RANDOM_MAC=n

CONFIG_NET_L2_ETHERNET=y
CONFIG_ETH_NATIVE_POSIX=y

CONFIG_NET_HOSTNAME_ENABLE=y
CONFIG_NET_HOSTNAME="zephyr2"
```

## zeth0.conf
```kconfig
#
# Configuration options for setting up the host network interface
#
INTERFACE="$1"
HWADDR="00:00:5e:00:53:03"
IPV6_ADDR_1="2001:db8:100::3"
IPV6_ROUTE_1="2001:db8:100:/64"
IPV4_ADDR_1="192.0.3.3"
IPV4_ROUTE_1="192.0.3.0/24"
ip link set dev $INTERFACE up
ip link set dev $INTERFACE address $HWADDR
ip -6 address add $IPV6_ADDR_1 dev $INTERFACE nodad
#ip -6 route add $IPV6_ROUTE_1 dev $INTERFACE
ip address add $IPV4_ADDR_1 dev $INTERFACE
#ip route add $IPV4_ROUTE_1 dev $INTERFACE > /dev/null 2>&1
```

## zeth1.conf
```kconfig
#
# Configuration options for setting up the host network interface
#
INTERFACE="$1"
HWADDR="00:00:5e:00:53:04"
IPV6_ADDR_1="2001:db8:100::4"
IPV6_ROUTE_1="2001:db8:100:/64"
IPV4_ADDR_1="192.0.3.3"
IPV4_ROUTE_1="192.0.3.0/24"
ip link set dev $INTERFACE up
ip link set dev $INTERFACE address $HWADDR
ip -6 address add $IPV6_ADDR_1 dev $INTERFACE nodad
#ip -6 route add $IPV6_ROUTE_1 dev $INTERFACE
ip address add $IPV4_ADDR_1 dev $INTERFACE
#ip route add $IPV4_ROUTE_1 dev $INTERFACE > /dev/null 2>&1
```

## zeth2.conf
```kconfig
#
# Configuration options for setting up the host network interface
#
INTERFACE="$1"
HWADDR="00:00:5e:00:53:33"
IPV6_ADDR_1="2001:db8:200::3"
IPV6_ROUTE_1="2001:db8:200:/64"
IPV4_ADDR_1="192.0.4.3"
IPV4_ROUTE_1="192.0.4.0/24"
ip link set dev $INTERFACE up
ip link set dev $INTERFACE address $HWADDR
ip -6 address add $IPV6_ADDR_1 dev $INTERFACE nodad
#ip -6 route add $IPV6_ROUTE_1 dev $INTERFACE
ip address add $IPV4_ADDR_1 dev $INTERFACE
#ip route add $IPV4_ROUTE_1 dev $INTERFACE > /dev/null 2>&1
```

## zeth3.conf
```kconfig
#
# Configuration options for setting up the host network interface
#
INTERFACE="$1"
HWADDR="00:00:5e:00:53:44"
IPV6_ADDR_1="2001:db8:200::4"
IPV6_ROUTE_1="2001:db8:200:/64"
IPV4_ADDR_1="192.0.4.4"
IPV4_ROUTE_1="192.0.4.0/24"
ip link set dev $INTERFACE up
ip link set dev $INTERFACE address $HWADDR
ip -6 address add $IPV6_ADDR_1 dev $INTERFACE nodad
#ip -6 route add $IPV6_ROUTE_1 dev $INTERFACE
ip address add $IPV4_ADDR_1 dev $INTERFACE
#ip route add $IPV4_ROUTE_1 dev $INTERFACE > /dev/null 2>&1
```

## src/main.c
```c
/*
 * Copyright (c) 2018 Intel Corporation
 *
 * SPDX-License-Identifier: Apache-2.0
 */

#include <logging/log.h>
LOG_MODULE_REGISTER(net_routing_sample, LOG_LEVEL_DBG);

#include <zephyr.h>
#include <errno.h>

#include <device.h>
#include <net/net_core.h>
#include <net/net_ip.h>
#include <net/net_if.h>

#define FIRST_IFACE	"zeth1"
#define SECOND_IFACE	"zeth2"
#define SECOND_ADDR	"2001:db8:200::1"

static struct net_if *get_iface(const char *name)
{
	struct net_if *iface;
	struct device *dev;

	dev = device_get_binding(name);
	if (!dev) {
		LOG_ERR("Cannot find iface device %s", name);
		return NULL;
	}

	iface = net_if_lookup_by_dev(dev);
	if (!iface) {
		LOG_ERR("Cannot find %s interface", name);
		return NULL;
	}

	return iface;
}

static int set_prefix(const char *dev, const char *prefix, int len)
{
	struct in6_addr addr;
	struct net_if *iface;
	struct net_if_ipv6_prefix *prefix_if;

	/* TODO IPv4 ? */
	if (net_addr_pton(AF_INET6, prefix, &addr)) {
		LOG_ERR("Invalid prefix: %s", prefix);
		return -EINVAL;
	}

	iface = get_iface(dev);
	if (!iface) {
		return -ENODEV;
	}

	prefix_if = net_if_ipv6_prefix_add(iface, &addr, len, 0);
	if (!prefix_if) {
		LOG_ERR("Cannot add %s/%d prefix", prefix, len);
		return -EINVAL;
	}

	return 0;
}

void main(void)
{
	struct in6_addr addr;
	struct net_if *iface;
	struct net_if_addr *ifaddr;
	struct net_if_ipv6_prefix *prefix;
	int err;

	LOG_INF("Start application");

	if (net_addr_pton(AF_INET6, SECOND_ADDR, &addr)) {
		LOG_ERR("Invalid address: %s", SECOND_ADDR);
		return;
	}

	iface = get_iface(SECOND_IFACE);
	if (!iface) {
		return;
	}

	ifaddr = net_if_ipv6_addr_add(iface, &addr, NET_ADDR_MANUAL, 0);
	if (!ifaddr) {
		LOG_ERR("Cannot add %s to interface", SECOND_ADDR);
		return;
	}

	err = set_prefix(CONFIG_NET_SAMPLE_IFACE1_DEV,
			 CONFIG_NET_SAMPLE_IFACE1_PREFIX,
			 CONFIG_NET_SAMPLE_IFACE1_PREFIX_LEN);
	if (err) {
		LOG_ERR("Cannot add %s/%d prefix",
			CONFIG_NET_SAMPLE_IFACE1_PREFIX,
			CONFIG_NET_SAMPLE_IFACE1_PREFIX_LEN);
		return;
	}

	err = set_prefix(CONFIG_NET_SAMPLE_IFACE2_DEV,
			 CONFIG_NET_SAMPLE_IFACE2_PREFIX,
			 CONFIG_NET_SAMPLE_IFACE2_PREFIX_LEN);
	if (err) {
		LOG_ERR("Cannot add %s/%d prefix",
			CONFIG_NET_SAMPLE_IFACE2_PREFIX,
			CONFIG_NET_SAMPLE_IFACE2_PREFIX_LEN);
		return;
	}

}
```
